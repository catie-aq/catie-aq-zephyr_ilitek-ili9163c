## drivers/display/Kconfig
```kconfig
# Copyright (c) 2024 CATIE
# SPDX-License-Identifier: Apache-2.0

if DISPLAY

rsource "ilitek/Kconfig"

endif
```

## drivers/display/ilitek/Kconfig
```kconfig
# drivers/display/Kconfig
# SPDX-License-Identifier: Apache-2.0

rsource "ili9163c/Kconfig"
```

## drivers/display/ilitek/ili9163c/Kconfig
```kconfig
# Copyright (c) 2024, CATIE
# SPDX-License-Identifier: Apache-2.0

menuconfig ILI9163C
    bool "ILI9163C display driver"
    default y
    depends on DT_HAS_ILITEK_ILI9163C_ENABLED
    select MIPI_DBI
    select PWM
    select GPIO
    help
    Enable driver for ILI9163C display driver.

if ILI9163C

config ILI9163C_READ
    bool "Allow display_read API with ILI9163C"
    help
    Support display_read API with ILI9163C controllers. This API is opt-in,
    because it adds code overhead and is not very performant due to
    the requirement to bitshift data read from the ILI9XXX. Note the
    API only supports RGB565 mode.
endif
```

## drivers/sensor/Kconfig
```kconfig
# Copyright (c) 2024 CATIE
# SPDX-License-Identifier: Apache-2.0

if SENSOR

rsource "ilitek/Kconfig"

endif # SENSOR
```

## drivers/sensor/ilitek/Kconfig
```kconfig
# Copyright (c) 2024 CATIE
# SPDX-License-Identifier: Apache-2.0

rsource "ili9163c/Kconfig"
```

## drivers/sensor/ilitek/ili9163c/Kconfig
```kconfig
# Copyright (c) 2024 CATIE
# SPDX-License-Identifier: Apache-2.0

menuconfig ILI9163C
    bool "ILITEK ILI9163C display controller sensor"
    default y
    depends on DT_HAS_ILITEK_ILI9163C_ENABLED
    help
      Enable driver for ILITEK ILI9163C display controller sensor.
```

## dts/bindings/display/ilitek,ili9163c.yaml
```yaml
# ilitek,ili9163.yaml

description: ILI9163C 128x160 display controller

compatible: "ilitek,ili9163c"

on-bus: mipi-dbi

include:
  - name: display-controller.yaml
  - name: mipi-dbi-device.yaml

properties:
  pixel-format:
    type: int
    default: 0
    enum:
      - 0 # RGB565
      - 1 # RGB888
    description:
      Display pixel format. Note that when RGB888 pixel format is selected
      only 6 color bits are actually used being in practice equivalent to
      RGB666.

  rotation:
    type: int
    default: 0
    enum:
      - 0
      - 90
      - 180
      - 270
    description:
      Display rotation (CW) in degrees.
      If not defined, rotation is off by default.

  display-inversion:
    type: boolean
    description:
      Display inversion mode. Every bit is inverted from the frame memory to
      the display.

  gamset:
    type: uint8-array
    default: [0x04]
    description:
      Gamma set (GAMSET) register value.

  gamadj:
    type: uint8-array
    default: [0x01]
    description:
      Gamma adjust value.

  frmctr1:
    type: uint8-array
    default: [0x0E, 0x14]
    description:
      Frame rate control (in normal mode / full colors) (FRMCTR1) register value.

  pgamctrl:
    type: uint8-array
    default: [0x3F, 0x25, 0x1C, 0x1E, 0x20, 0x12, 0x2A, 0x90, 0x24, 0x11, 0x00, 0x00, 0x00, 0x00, 0x00]
    description:
      Positive gamma correction (PGAMCTRL) register values.

  ngamctrl:
    type: uint8-array
    default: [0x20, 0x20, 0x20, 0x20, 0x05, 0x00, 0x15, 0xA7, 0x3D, 0x18, 0x25, 0x2A, 0x2B, 0x2B, 0x3A]
    description:
      Negative gamma correction (NGAMCTRL) register values.

  pwctrl1:
    type: uint8-array
    default: [0x0A, 0x05]
    description:
      Power control 1 - GVDD and voltage.

  pwctrl2:
    type: uint8-array
    default: [0x07]
    description:
      Power control 2 - AVDD, VCL, VGH and VGL supply power level.

  pwctrl3:
    type: string
    default: "Least"
    description:
      Power control 3 - amount of current in Operation amplifier.
    enum:
      - "Least"
      - "Small"
      - "Medium Low"
      - "Medium"
      - "Medium High"
      - "Large"

  pwctrl4:
    type: string
    default: "Least"
    description:
      Power control 4 - amount of current in Operational amplifier in Idle.
    enum:
      - "Least"
      - "Small"
      - "Medium Low"
      - "Medium"
      - "Medium High"
      - "Large"

  vmctrl1:
    type: uint8-array
    default: [0x43, 0x4D]
    description:
      VCOM control 1 - Set VCOMH Voltage.

  vmctrl2:
    type: uint8-array
    default: [0x40]
    description:
      VCOM control 2 - Set VCOMH Voltage.

  pwms:
    type: phandle-array
    description:
      PWM phandles for backlight control.
```

## dts/bindings/sensor/ilitek,ili9163c.yaml
```yaml
# Copyright (c) 2024 CATIE
# SPDX-License-Identifier: Apache-2.0

description: |
    ILITEK ILI9163C display controller sensor

compatible: "ilitek,ili9163c"

include: [sensor-device.yaml]
```
